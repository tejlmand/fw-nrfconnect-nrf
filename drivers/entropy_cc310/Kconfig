## drivers/entropy_cc310/Kconfig
```kconfig
# Kconfig - Arm CC310 entropy driver for nRF52840 and nRF9160
#
# Copyright (c) 2018 Nordic Semiconductor
#
# SPDX-License-Identifier: LicenseRef-BSD-5-Clause-Nordic
#

config ENTROPY_CC310_FORCE_ALT
	bool
	depends on SOC_COMPATIBLE_NRF
	help
	  This option can be enabled to force an alternative implementation of
	  the Arm CC310 entropy driver.

if !ENTROPY_CC310_FORCE_ALT

menuconfig ENTROPY_CC310_RNG
	bool "Arm CC310 RNG driver for Nordic devices"
	depends on SOC_NRF52840 || SOC_NRF9160
	depends on !ENTROPY_NRF5_RNG
	select ENTROPY_HAS_DRIVER
	select MBEDTLS
	select NORDIC_SECURITY_BACKEND
	select MBEDTLS_CC310_BACKEND
	default y
	help
	  This option enables the Arm CC310 RNG devices in nRF52840 and nRF9160
	  devices. This is dependant on nrf_cc310_mbedcrypto being enabled in
	  the system, e.g. through the nrf_security module

endif # !ENTROPY_CC310_FORCE_ALT
```

## lib/nrf_modem_lib/Kconfig
```kconfig
# Copyright (c) 2018 Nordic Semiconductor
#
# SPDX-License-Identifier: LicenseRef-BSD-5-Clause-Nordic
#

config BSD_LIBRARY
	bool
	prompt "Use BSD Socket library for IP/TLS/DTLS (deprecated)"
	select NRF_MODEM_LIB
	help
	  BSD_LIBRARY is deprecated, please use NRF_MODEM_LIB instead.

if BSD_LIBRARY
	comment "BSD_LIBRARY is deprecated, please use NRF_MODEM_LIB instead."
endif

menuconfig NRF_MODEM_LIB
	bool "Enable Modem library"
	imply NRFX_IPC
	imply NET_SOCKETS_OFFLOAD
	imply NET_SOCKETS_POSIX_NAMES
	select NRF_MODEM
	help
	  Use Nordic Modem library.

if NRF_MODEM_LIB

config NRF_MODEM_LIB_SYS_INIT
	bool "Initialize during SYS_INIT"
	default y
	help
	  Initialize the Modem library automatically during the SYS_INIT sequence.
	  Please note that initialization is synchronous and can take up to one
	  minute in case the modem firmware is updated.

config NRF_MODEM_LIB_TRACE_ENABLED
	bool
	prompt "Enable proprietary traces over UART"
	# Modem tracing over UART use the UARTE1 as dedicated peripheral.
	# This enable UARTE1 peripheral and includes nrfx UARTE driver.
	select NRFX_UARTE1

config NRF91_SOCKET_SEND_SPLIT_LARGE_BLOCKS
	bool "Split large blocks passed to send() or sendto()"
	default n
	help
	  Workaround a limitation in the Modem library regarding the return
	  value for send() or sendto() calls larger than the module can handle.
	  It should send the data up to the maximum, and return that as the return value.
	  Instead, it returns error 22.

config NRF91_SOCKET_BLOCK_LIMIT
	int "Maximum size the modem can send"
	default 2048
	help
	  Blocks larger than this value will be split into two or more
	  send() or sendto() calls. This may not work for certain kinds
	  of sockets or certain flag parameter values.

config NRF_MODEM_LIB_SENDMSG_BUF_SIZE
	int "Size of the sendmsg intermediate buffer"
	default 128
	help
	  Size of an intermediate buffer used by `sendmsg` to repack data and
	  therefore limit the number of `sendto` calls. The buffer is created
	  in a static memory, so it does not impact stack/heap usage. In case
	  the repacked message would not fit into the buffer, `sendmsg` sends
	  each message part separately.

if BSD_LIBRARY

comment "BSD_LIBRARY settings (Deprecated)."

config BSD_LIBRARY_TRACE_ENABLED
	bool
	prompt "BSD_LIB: Enable proprietary traces over UART (deprecated)"
	select NRF_MODEM_LIB_TRACE_ENABLED
	help
	  BSD_LIBRARY_TRACE_ENABLED is deprecated, please use NRF_MODEM_LIB_TRACE_ENABLED instead.

if BSD_LIBRARY_TRACE_ENABLED
	comment	"BSD_LIBRARY_TRACE_ENABLED is deprecated, please use NRF_MODEM_LIB_TRACE_ENABLED instead."
endif

endif # BSD_LIBRARY

endif # NRF_MODEM_LIB
```

## subsys/bootloader/Kconfig
```kconfig
#
# Copyright (c) 2018 Nordic Semiconductor ASA
#
# SPDX-License-Identifier: LicenseRef-BSD-5-Clause-Nordic
#

config SECURE_BOOT
# TODO boot - bootloader - really?
	bool "Use Secure Boot"
	depends on !IS_SECURE_BOOTLOADER

if SECURE_BOOT

config SB_SIGNING_KEY_FILE
	string "Private key PEM file"
	default ""
	help
	  Absolute path to the private key PEM file.
	  Specifies the private key used for signing the firmware image.
	  The hash of the corresponding public key is stored as the first
	  entry in the list of public key hashes in the provision hex file.
	  This value can also be set by exporting an environment variable
	  named 'SB_SIGNING_KEY_FILE' or passing
	  '-DSB_SIGNING_KEY_FILE=/path/to/my/pem' when running cmake.
	  See also SB_PUBLIC_KEY_FILES.

config SB_PUBLIC_KEY_FILES
	string "Public Key PEM files"
	default ""
	help
	  Comma-separated list of absolute paths to public key pem files.
	  The provision hex file will contain a list of hashes of public keys.
	  The first public key hash is the one corresponding to the private
	  signing key used to sign the image. See SB_SIGNING_KEY_FILE.
	  The hashes of the public keys specified in this configuration will be
	  placed after the aforementioned private key hash, in the order
	  they appear in this config.
	  If config is an empty string, 2 generated debug files
	  will be used.
	  Example value: ~/keys/pk1.pem,~/keys/pk2.pem,~/keys/pk3.pem


endif # SECURE_BOOT

menuconfig IS_SECURE_BOOTLOADER
	bool "Current app is bootloader"
	select SECURE_BOOT_CRYPTO
	select SB_FLASH_PROTECT
	depends on !KERNEL

if IS_SECURE_BOOTLOADER

rsource "debug/Kconfig"

rsource "c_runtime_setup/Kconfig"

rsource "fprotect/Kconfig"

endif # IS_SECURE_BOOTLOADER

if IS_SECURE_BOOTLOADER || SECURE_BOOT
rsource "bl_crypto/Kconfig"

rsource "fw_metadata/Kconfig"
endif # IS_SECURE_BOOTLOADER || SECURE_BOOT

if ZTEST && !IS_SECURE_BOOTLOADER
rsource "bl_crypto/Kconfig"
endif # ZTEST
```

## subsys/spu_setup/Kconfig
```kconfig
config SPU_SETUP
	bool "SPU Setup"
	default y
	depends on HAS_HW_NRF_SPU
	depends on !IS_SPU_SETUP
	help
	  Enable SPU configuration for nRF91
	  

menuconfig IS_SPU_SETUP
	bool "Current app is SPU setup"
	#TODO: Build without zephyr kernel
	#depends on !KERNEL
	bool

if IS_SPU_SETUP

config PARTITION_MANAGER_RESERVED_SPU_CONFIGURATION
	hex "Flash space reserved for bootloader."
	default 0x4000
	help
	  Flash space set aside for the SPU configuration. Note, the name
	  of this configuration needs to match the requirements set by the
	  script 'partition_manager.py'. See pm.yaml.

endif
```

## subsys/spu_setup/Kconfig.spu
```kconfig
config SPU_SETUP 
	bool "SPU Setup"
	default n #TODO: Smart way of enablign spu based on properties
	depends on HAS_HW_NRF_SPU
	depends on !IS_SPU_SETUP
	help
	  Enable SPU configuration for nRF91

config PARTITION_MANAGER_RESERVED_SPACE_SPU_SETUP
	hex "Flash space reserved for bootloader."
	default 0x4000
	help
	  Flash space set aside for the SPU configuration. Note, the name
	  of this configuration needs to match the requirements set by the
	  script 'partition_manager.py'. See pm.yaml.
```
