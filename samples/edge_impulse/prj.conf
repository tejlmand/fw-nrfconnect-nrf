## prj.conf
```kconfig
# Required by Edge Impulse library
CONFIG_CPLUSPLUS=y
CONFIG_LIB_CPLUSPLUS=y
CONFIG_NEWLIB_LIBC=y
CONFIG_NEWLIB_LIBC_FLOAT_PRINTF=y
CONFIG_STD_CPP11=y
CONFIG_FPU=y

CONFIG_MAIN_STACK_SIZE=8192
CONFIG_CONSOLE_SUBSYS=y
CONFIG_CONSOLE_GETLINE=y

CONFIG_EDGE_IMPULSE=y
CONFIG_EDGE_IMPULSE_DOWNLOAD_URI="https://studio.edgeimpulse.com/v1/api/10607/deployment/download?type=zip"
```

## src/main.cpp
```c
#include <zephyr.h>
#include <ei_run_classifier.h>
#include <numpy.hpp>

/* Include hardcoded features array used as input for classifier. */
#include "features.h"


static int raw_feature_get_data(size_t offset, size_t length, float *out_ptr)
{
	memcpy(out_ptr, features + offset, length * sizeof(float));
	return 0;
}

void main(void)
{
	/* Display output of printf immediately without buffering. */
	setvbuf(stdout, NULL, _IONBF, 0);

	printk("Edge Impulse sample\n");

	if (ARRAY_SIZE(features) != EI_CLASSIFIER_DSP_INPUT_FRAME_SIZE) {
		printk("The size of your 'features' array is not correct."
		       "Expected %d items, but had %u\n", EI_CLASSIFIER_DSP_INPUT_FRAME_SIZE,
			ARRAY_SIZE(features));
		return;
	}

	ei_impulse_result_t result = { 0 };

	/* Periodically perform prediction and print results. */
	while (1) {
		/* The features are stored in flash, we don't want to load everything into RAM. */
		signal_t features_signal;
		features_signal.total_length = ARRAY_SIZE(features);
		features_signal.get_data = &raw_feature_get_data;

		/* Invoke the impulse. */
		EI_IMPULSE_ERROR res = run_classifier(&features_signal, &result, true);
		printk("run_classifier returned: %d\n", res);

		if (res != 0) {
			printk("run_classifier returned an error. Program execution stopped.\n");
			return;
		}

	        printk("Predictions (DSP: %d ms., Classification: %d ms., Anomaly: %d ms.): \n",
		       result.timing.dsp, result.timing.classification, result.timing.anomaly);

		/* Print prediction results. */
		printk("[");
		for (size_t ix = 0; ix < EI_CLASSIFIER_LABEL_COUNT; ix++) {
			ei_printf_float(result.classification[ix].value);
			if (ix != EI_CLASSIFIER_LABEL_COUNT - 1) {
				printk(", ");
			}
		}
		if (EI_CLASSIFIER_HAS_ANOMALY) {
			printk(", ");
			ei_printf_float(result.anomaly);
		}
		printk("]\n");

		k_msleep(2000);
	}
}
```

## include/features.h
```c
static const float features[] = {
    /* Copy raw features here (for example from the 'Live classification' page)
     * See https://docs.edgeimpulse.com/docs/running-your-impulse-zephyr.
     */
-1.8675, -1.0200, 9.4454, -1.8077, -1.1828, 9.4550, -0.8763, -1.0774, 9.6944, -0.8763, -1.0774, 9.6944, 0.0455, -1.1469, 9.5795, 0.2825, -1.1301, 9.5077, 0.3184, -1.1421, 9.7878, 1.1397, -1.0822, 9.7040, 0.9721, -1.2738, 10.3912, 0.0718, -1.8795, 9.0767, -0.6752, -2.0399, 9.2204, -1.0822, -2.3105, 9.8285, -1.0822, -2.3105, 9.8285, -0.5842, -1.5156, 9.5795, 0.1269, -1.4174, 9.3616, -1.1804, -1.4653, 9.7279, -1.2905, -1.5539, 9.0863, -1.8244, -1.7909, 9.4933, -1.5730, -1.8196, 9.4239, -1.3169, -1.7933, 9.4718, -0.3328, -1.7526, 9.5412, 1.0391, -1.8771, 9.6753, 1.3049, -1.9920, 9.6322, 0.9529, -1.9178, 9.8141, 0.5962, -2.0950, 9.5244, 0.4789, -1.9394, 9.8429, -2.0351, -2.9713, 9.4789, -0.5986, -2.7079, 9.5077, -0.5986, -2.7079, 9.5077, -0.4405, -2.5451, 9.3640, -0.6728, -0.4070, 8.6960, 1.1109, -3.0024, 10.9323, 2.0016, -3.6273, 9.9099, -0.1197, -3.4238, 9.8333, -0.8883, -4.4869, 8.9354, -1.1684, -5.1070, 9.3736, -1.3599, -4.2738, 9.6441, -1.9944, -2.2626, 9.5627, -2.4781, -1.6185, 9.8069, -1.9992, -1.2522, 9.1270, -2.1932, -1.4174, 9.4622, -1.7837, -2.6792, 9.1940, -1.6497, -3.0383, 9.8788, -0.4669, -4.1062, 9.1461, -0.5267, -3.1461, 9.3975, -0.5076, -3.1700, 9.5556, -0.4621, -3.7183, 9.2706, -0.7542, -3.6106, 9.6370, -1.3647, -3.7351, 9.6465, -1.4797, -3.4669, 9.4694, -1.4797, -3.0862, 9.7519, -1.2307, -2.6768, 9.5795, -1.0750, -2.0375, 9.5244, -1.0750, -2.0375, 9.5244, -1.1157, -1.6928, 9.4047, -0.9074, -1.5060, 9.4550, -1.0846, -1.0726, 9.3137, -1.2450, -0.8715, 9.6274, -1.4509, -0.8093, 9.1940, -1.7718, -0.7470, 9.4694, -1.5802, -1.0032, 9.4741, -0.9386, -1.2259, 9.4119, 1.0870, -1.4605, 9.6010, 1.3001, -1.5611, 9.5125, 0.0646, -1.3264, 10.0655, -0.9912, -1.5012, 9.8309, -0.9888, -1.4102, 9.6561, -0.7326, -1.5970, 9.3113, 0.0958, -1.8891, 9.4502, 0.3065, -2.1405, 9.7806, -0.1700, -2.2746, 9.6441, -1.1301, -2.3895, 9.6130, -0.4142, -2.5331, 9.5603, 0.1772, -2.4230, 9.7471, 0.0263, -2.2267, 9.6489, -0.8332, -2.1692, 9.3305, -1.4629, -1.8915, 9.4598, -1.4629, -1.8915, 9.4598, -2.5212, -1.5419, 9.3449, -2.7223, -1.3599, 9.2108, -2.5044, -1.3695, 9.4119, -0.2275, -1.4007, 9.7208, 0.4597, -1.3719, 9.5675, -1.8771, -2.8612, 9.1940, -1.6042, -2.2171, 8.9785, -0.0311, -2.3871, 9.0192, 0.7901, -2.2506, 9.9722, 1.6568, -2.4398, 9.6777, 2.3440, -2.4062, 10.1254, 2.7798, -1.7454, 9.7686, -5.7343, 1.8843, 10.1829, -3.4142, -0.2993, 7.8987, 0.0934, -6.6178, 11.3273, -0.8236, -6.3688, 11.1238, -0.7901, -6.1653, 8.7008, -0.9984, -5.5858, 9.4957, -0.7781, -5.0687, 8.4997, -0.4884, -3.8620, 10.0176, -3.4142, -2.4086, 9.6801, -3.8452, -1.8508, 9.6393, -4.0248, -1.7239, 9.0001, -4.0870, -1.6473, 9.2682, -4.0870, -1.6473, 9.2682, -2.3847, -2.3392, 9.5891, -1.8747, -3.5938, 9.6872, -0.5172, -4.3145, 9.8405, -1.1157, -3.0455, 9.9075, -2.1525, -3.1413, 9.2898, -1.5491, -3.4214, 9.4143, -2.1094, -3.0024, 9.9865, -1.9849, -2.9234, 9.2802, -2.1285, -2.1237, 9.7662, -1.6616, -1.8244, 9.6274, -0.9601, -1.2666, 9.5603, -0.0575, -1.1780, 9.1940, -0.1963, -0.9673, 9.6130, -0.4405, -1.0750, 9.2060, -0.5674, -1.0271, 9.9099, 0.2801, -0.9170, 9.6465, 0.8787, -1.2091, 9.6681, 1.2426, -1.6425, 9.7255, 0.8236, -1.7718, 9.6010, -1.3264, -1.8963, 9.5627, -1.5659, -1.8244, 9.5244, -0.9122, -1.8963, 9.7088

};
```
